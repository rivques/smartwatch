## main/Kconfig.projbuild
```kconfig
menu "WiFi Configuration"

    config WIFI_SSID
        string "WiFi SSID"
        default "YourSSID"
        help
            Enter the SSID of the WiFi network.
    
    config WIFI_PASSWORD
        string "WiFi Password"
        default "YourPassword"
        help
            Enter the password for the WiFi network.
    
    endmenu
    
```
